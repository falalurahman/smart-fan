## sdkconfig.defaults.esp32c6
```kconfig
# ESP32-C6: Matter over WiFi

# WiFi
CONFIG_ENABLE_WIFI_STATION=y
# CONFIG_ENABLE_WIFI_AP is not set
CONFIG_ESP_WIFI_SOFTAP_SUPPORT=y
CONFIG_USE_BLE_ONLY_FOR_COMMISSIONING=y

# LwIP IPv6
CONFIG_LWIP_IPV6_AUTOCONFIG=y
CONFIG_LWIP_IPV6_NUM_ADDRESSES=6

# Use minimal mDNS for WiFi
CONFIG_USE_MINIMAL_MDNS=y

# Disable OpenThread
# CONFIG_OPENTHREAD_ENABLED is not set
```
